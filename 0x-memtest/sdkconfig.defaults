## 0x-memtest/sdkconfig.defaults
```kconfig
# Arduino Nano ESP32 board uses an ESP32-S3 chip
CONFIG_IDF_TARGET="esp32s3"

# 16 MB of QIO Flash:
CONFIG_ESPTOOLPY_FLASHMODE_QIO=y
CONFIG_ESPTOOLPY_FLASHSIZE_16MB=y

# 8MB of OPI PSRAM:
CONFIG_SPIRAM=y
CONFIG_SPIRAM_MODE_OCT=y
CONFIG_SPIRAM_SPEED_80M=y

# 32kHZ crystal is used for RTC:
CONFIG_RTC_CLK_SRC_EXT_CRYS=y

# Console goes over USB Serial/JTAG peripheral:
CONFIG_ESP_CONSOLE_USB_SERIAL_JTAG=y

CONFIG_FREERTOS_HZ=1000
```

## 0x-tester/sdkconfig.defaults
```kconfig
# Arduino Nano ESP32 board uses an ESP32-S3 chip
CONFIG_IDF_TARGET="esp32s3"

# 16 MB of QIO Flash:
CONFIG_ESPTOOLPY_FLASHMODE_QIO=y
CONFIG_ESPTOOLPY_FLASHSIZE_16MB=y

# 8MB of OPI PSRAM:
CONFIG_SPIRAM=y
CONFIG_SPIRAM_MODE_OCT=y
CONFIG_SPIRAM_SPEED_80M=y

# 32kHZ crystal is used for RTC:
CONFIG_RTC_CLK_SRC_EXT_CRYS=y
CONFIG_ESP_DEFAULT_CPU_FREQ_MHZ_240=y

# Console goes over USB Serial/JTAG peripheral:
CONFIG_ESP_CONSOLE_USB_SERIAL_JTAG=y

# FREERTOS config
CONFIG_FREERTOS_HZ=1000
CONFIG_TASK_WDT_TIMEOUT_S=60
```

## mcugdx/examples/audio/sdkconfig.defaults
```kconfig
# Arduino Nano ESP32 board uses an ESP32-S3 chip
CONFIG_IDF_TARGET="esp32s3"

# 16 MB of QIO Flash:
CONFIG_ESPTOOLPY_FLASHMODE_QIO=y
CONFIG_ESPTOOLPY_FLASHSIZE_16MB=y

# 8MB of OPI PSRAM:
CONFIG_SPIRAM=y
CONFIG_SPIRAM_MODE_OCT=y
CONFIG_SPIRAM_SPEED_80M=y

# 32kHZ crystal is used for RTC:
CONFIG_RTC_CLK_SRC_EXT_CRYS=y

# Console goes over USB Serial/JTAG peripheral:
CONFIG_ESP_CONSOLE_USB_SERIAL_JTAG=y

# FREERTOS config
CONFIG_TASK_WDT_TIMEOUT_S=60

# Custom partitions
CONFIG_PARTITION_TABLE_CUSTOM=y
CONFIG_PARTITION_TABLE_CUSTOM_FILENAME="partitions.csv"
CONFIG_PARTITION_TABLE_FILENAME="partitions.csv"
CONFIG_PARTITION_TABLE_OFFSET=0x8000
CONFIG_PARTITION_TABLE_MD5=y
```

## mcugdx/examples/neopixels/sdkconfig.defaults
```kconfig
CONFIG_IDF_TARGET="esp32s3"

# Common
CONFIG_COMPILER_OPTIMIZATION_PERF=y
CONFIG_ESP_DEFAULT_CPU_FREQ_MHZ_240=y
CONFIG_RTC_CLK_SRC_EXT_CRYS=y
CONFIG_ESP_CONSOLE_USB_SERIAL_JTAG=y
CONFIG_TASK_WDT_TIMEOUT_S=60
CONFIG_PARTITION_TABLE_CUSTOM=y
CONFIG_SPIRAM=y
CONFIG_IDF_EXPERIMENTAL_FEATURES=y
CONFIG_ESPTOOLPY_FLASHMODE_QIO=y

# Arduino Nano ESP32, 16MB Flash, 8MB octal PSRAM @ 120Mhz (temperature sensitive, see docs)
#CONFIG_ESPTOOLPY_FLASHSIZE_16MB=y
#CONFIG_SPIRAM_MODE_OCT=y
#CONFIG_SPIRAM_SPEED_120M=y
#CONFIG_ESPTOOLPY_FLASHFREQ_120M=y

# Waveshare ESP32-S3-Zero, 4MB Flash, 2MB PSRAM @ 80Mhz
CONFIG_ESPTOOLPY_FLASHSIZE_4MB=y
CONFIG_SPIRAM_SPEED_80M=y

# Unexpected Maker PRO-S3, 16MB Flash, 8MB PSRAM @ 80Mhz

#CONFIG_ESPTOOLPY_FLASHSIZE_16MB=y
#CONFIG_SPIRAM_SPEED_80M=y
```
